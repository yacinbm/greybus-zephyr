## prj.conf
```kconfig
# Copyright (c) 2025 Ayush Singh, BeagleBoard.org
#
# SPDX-License-Identifier: Apache-2.0

CONFIG_GREYBUS=y
# CONFIG_GREYBUS_SVC=y
# CONFIG_GREYBUS_APBRIDGE=y

CONFIG_LOG=y
CONFIG_LOG_BUFFER_SIZE=16384
CONFIG_GREYBUS_LOG_LEVEL_DBG=y

CONFIG_BT=y
CONFIG_BT_HCI_RAW=y
CONFIG_BT_MAX_CONN=16
CONFIG_BT_CTLR_PRIVACY=n
CONFIG_GREYBUS_BT_HCI=y

CONFIG_PRINT_MANIFEST=y

CONFIG_GREYBUS_XPORT_UART_HDLC=y

CONFIG_QEMU_EXTRA_FLAGS="-serial pty"
```

## transport-dummy.conf
```kconfig
# Copyright (c) 2025 Ayush Singh, BeagleBoard.org
#
# SPDX-License-Identifier: Apache-2.0

CONFIG_GREYBUS_XPORT_DUMMY=y
CONFIG_PRINT_MANIFEST=y

# Having logging enabled causes messages to drop, thus causing parts of manifest to not print.
# CONFIG_LOG=n
```

## boards/xg24_rb4187c.conf
```kconfig
CONFIG_UART_LINE_CTRL=y
CONFIG_UART_INTERRUPT_DRIVEN=y
CONFIG_GREYBUS_UART=y

CONFIG_GREYBUS_LOOPBACK=y
CONFIG_GREYBUS_LOG_BACKEND=y

CONFIG_UART_CONSOLE=n
CONFIG_LOG_BACKEND_SWO=y
```

## boards/xg24_rb4187c.overlay
```dts
/ {
	zephyr,greybus {
		//gbbundle1 {
		//	status = "okay";
		//	compatible = "zephyr,greybus-bundle-bridged-phy";
		//	uart-controllers = <&eusart1>;
		//};
	};
};

    &eusart0 {
			compatible = "silabs,eusart-uart";
			status = "okay";
    };

    &eusart1 {
			compatible = "silabs,eusart-uart";
			pinctrl-0 = <&eusart1_default>;
			pinctrl-names = "default";
			status = "okay";
			/delete-property/ cs-gpios;
    };
```

## src/main.c
```c
/*
 * Copyright (c) 2025 Ayush Singh BeagleBoard.org
 *
 * SPDX-License-Identifier: Apache-2.0
 */

#include <zephyr/drivers/uart.h>
#include <zephyr/logging/log.h>
#include <zephyr/sys/printk.h>
#include <zephyr/kernel.h>

#include <greybus/greybus.h>

#ifdef CONFIG_PRINT_MANIFEST
#include "greybus-utils/manifest.h"
#endif // CONFIG_PRINT_MANIFEST

LOG_MODULE_REGISTER(main, CONFIG_GREYBUS_LOG_LEVEL);

// #define UART_DEVICE_NODE DT_CHOSEN(zephyr_bt_mon_uart)
// static const struct device *const uart_dev = DEVICE_DT_GET(UART_DEVICE_NODE);

int main(void)
{
#ifdef CONFIG_PRINT_MANIFEST
	static char manifest[1024];
	int ret = manifest_create(manifest, ARRAY_SIZE(manifest));
	LOG_DBG("Manifest Size: %d\n", ret);

	manifest_print(manifest);
#endif // CONFIG_PRINT_MANIFEST

	// if (!device_is_ready(uart_dev)) {
	// 	LOG_ERR("UART device not ready");
	// 	return -ENODEV;
	// }

	k_sleep(K_FOREVER);

	return 0;
}
```
